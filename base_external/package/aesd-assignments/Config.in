## base_external/package/aesd-assignments/Config.in
```kconfig
config BR2_PACKAGE_AESD_ASSIGNMENTS
	bool "aesd-assignments"
	help
	  Installs the writer executable, finder.sh and finder-test.sh
	  along with the Assignment 3 configuration files.
```
